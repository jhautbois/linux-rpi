## Documentation/devicetree/bindings/media/brcm,bcm2835-unicam.yaml
```yaml
# SPDX-License-Identifier: (GPL-2.0-only OR BSD-2-Clause)
%YAML 1.2
---
$id: http://devicetree.org/schemas/media/brcm,bcm2835-unicam.yaml#
$schema: http://devicetree.org/meta-schemas/core.yaml#

title: Broadcom BCM283x Camera Interface (Unicam)

maintainers:
  - Dave Stevenson <dave.stevenson@raspberrypi.com>

description: |-
  The Unicam block on BCM283x SoCs is the receiver for either
  CSI-2 or CCP2 data from image sensors or similar devices.

  The main platform using this SoC is the Raspberry Pi family of boards.
  On the Pi the VideoCore firmware can also control this hardware block,
  and driving it from two different processors will cause issues.
  To avoid this, the firmware checks the device tree configuration
  during boot. If it finds device tree nodes starting by csi then
  it will stop the firmware accessing the block, and it can then
  safely be used via the device tree binding.

properties:
  compatible:
    const: brcm,bcm2835-unicam

  reg:
    maxItems: 2

  interrupts:
    maxItems: 1

  clocks:
    items:
      - description: Clock for the camera.
      - description: Clock for the vpu.

  clock-names:
    items:
      - const: lp
      - const: vpu

  power-domains:
    items:
      - description: Unicam power domain

  num-data-lanes:
    items:
      - enum: [ 2, 4 ]

  port:
    additionalProperties: false
    $ref: /schemas/graph.yaml#/$defs/port-base

    properties:
      endpoint:
        $ref: /schemas/media/video-interfaces.yaml#
        unevaluatedProperties: false

        properties:
          data-lanes: true
          link-frequencies: true

        required:
          - data-lanes
          - link-frequencies

    required:
      - endpoint

required:
  - compatible
  - reg
  - interrupts
  - clocks
  - clock-names
  - power-domains
  - num-data-lanes
  - port

additionalProperties: False

examples:
  - |
    #include <dt-bindings/clock/bcm2835.h>
    #include <dt-bindings/interrupt-controller/arm-gic.h>
    #include <dt-bindings/power/raspberrypi-power.h>
    csi1: csi@7e801000 {
        compatible = "brcm,bcm2835-unicam";
        reg = <0x7e801000 0x800>,
              <0x7e802004 0x4>;
        interrupts = <GIC_SPI 103 IRQ_TYPE_LEVEL_HIGH>;
        clocks = <&clocks BCM2835_CLOCK_CAM1>,
                 <&firmware_clocks 4>;
        clock-names = "lp", "vpu";
        power-domains = <&power RPI_POWER_DOMAIN_UNICAM1>;
        num-data-lanes = <2>;
        port {
                csi1_ep: endpoint {
                        remote-endpoint = <&imx219_0>;
                        data-lanes = <1 2>;
                        link-frequencies = /bits/ 64 <456000000>;
                };
        };
    };
...
```
